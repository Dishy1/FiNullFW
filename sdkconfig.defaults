## sdkconfig.defaults
```kconfig
CONFIG_PARTITION_TABLE_CUSTOM=y
CONFIG_PARTITION_TABLE_CUSTOM_FILENAME="partitions.csv"
CONFIG_PARTITION_TABLE_FILENAME="partitions.csv"
CONFIG_PARTITION_TABLE_OFFSET=0x8000
CONFIG_SPIRAM_SUPPORT=y
CONFIG_ESPTOOLPY_FLASHSIZE_8MB=y

# Wi-Fi (mesh backbone)
CONFIG_WIFI_SSID="FiNULLMesh"
CONFIG_WIFI_PASSWORD="finullfinull"

# Mesh settings
CONFIG_MESH_IDF_ENABLE=y
CONFIG_MESH_ROUTER_SSID="FiNULLMeshSlave"
CONFIG_MESH_ROUTER_PASSWD="finullfinull"
CONFIG_MESH_CHANNEL=0
CONFIG_MESH_MAX_LAYER=6
CONFIG_MESH_AP_CONNECTIONS=6
CONFIG_MESH_ROOT_HEAL=y
CONFIG_MESH_VOTE_PERCENTAGE=90
CONFIG_MESH_XON_XOFF=y
```
